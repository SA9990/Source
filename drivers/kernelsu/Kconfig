## drivers/kernelsu/Kconfig
```kconfig
menu "KernelSU"

config KSU
	bool "KernelSU function support"
	select OVERLAY_FS
	select EXT4_FS
	default y
	help
	  Enable kernel-level root privileges on Android System.

config KSU_DEBUG
	bool "KernelSU debug mode"
	depends on KSU
	default n
	help
	  Enable KernelSU debug mode.

config KSU_ALLOWLIST_WORKAROUND
        bool "KernelSU Session Keyring Init workaround"
        depends on KSU
        default n
        help
          Enable session keyring init workaround for problematic devices.
          Useful for situations where the SU allowlist is not kept after a reboot.

config KSU_LSM_SECURITY_HOOKS
	bool "use lsm security hooks"
        depends on KSU
        default y
	help
	  Disabling this is mostly only useful for kernel 4.1 and older.
	  Make sure to implement manual hooks on security/security.c.

config KSU_USE_STRUCT_FILENAME
	bool "use struct filename"
        depends on KSU
        default y
	help
	  Disable this to remove all functions using 'struct filename'. Also useful if
	  youre using pure syscall hooks and your compiler/linker lacks DCE.
	  Make sure you are using proper sys_execve / compat_sys_execve hooks.

endmenu
```
